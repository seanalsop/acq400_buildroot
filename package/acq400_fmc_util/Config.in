## package/acq400_fmc_util/Config.in
```kconfig
config BR2_PACKAGE_ACQ400_FMC_UTIL
	bool "acq400_fmc_util"
	help
	  ACQ400 FMC support - fru-dump-acq, from Rubini 2013
	
```

## package/acq400_procServ/Config.in
```kconfig
config BR2_PACKAGE_ACQ400_PROCSERV
	bool "acq400_procServ"
	help
	  ACQ400 process launcher
```

## package/acq400_util/Config.in
```kconfig
config BR2_PACKAGE_ACQ400_UTIL
	bool "acq400_util"
	help
	  ACQ400 Utils fs2xml  ob_calc_527 daemon xiloader
```

## package/ckermit/Config.in
```kconfig
config BR2_PACKAGE_CKERMIT
	bool "ckermit"
	help
	  kermit communications program http://www.kermitproject.org/ckdaily.html
```

## package/netkit-ftp/Config.in
```kconfig
config BR2_PACKAGE_NETKIT_FTP
	bool "netkit_ftp"
	help
	  Classic FTP client
	  
```

## package/python-salt-ssh/Config.in
```kconfig
config BR2_PACKAGE_PYTHON_SALT_SSH
	bool "python_salt_ssh"
	help
		salt_ssh agent free minion
```

## package/tclx/Config.in
```kconfig
config BR2_PACKAGE_TCLX
	bool "tclx"
	help
	  TclX, or Extended Tcl, provides access to the features exposed by API of POSIX systems such Unix.
	  https://wiki.tcl-lang.org/page/TclX
```
